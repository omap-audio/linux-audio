## Documentation/devicetree/bindings/arm/omap/dma-crossbar.txt
```
Some socs have a crossbar ip which muxes the dma requests
from the peripherals to the dma request input lines of the
appropriate dma controller. With this the dma controller's
available request lines are shared between the peripherals

Required properties:
- compatible : Should be "ti,dma-crossbar"
- reg: Base address and the size of the crossbar registers.
- ti,dma-reqs: Total number of dma request lines available at dma controller.
- ti,reg-size: Size of a individual register in bytes. Every individual
	    register is assumed to be of same size. Valid sizes are 1, 2, 4.
- ti,dmas-reserved: List of the reserved dma lines that are not muxed using
		 crossbar. These dma lines are reserved in the soc,
		 so crossbar bar driver should not consider them as free
		 lines. This is a table of dma request-number and a count of
		 reserved values from that number.

Examples:
		crossbar_dma: crossbar@4a020000 {
			compatible = "ti,dma-crossbar";
			reg = <0x4a002b78 0x100>;
			ti,dma-reqs = <160>;
			ti,reg-size = <2>;
			ti,dmas-reserved = < 2, 5,
					     10, 2 >;
		};
```

## Documentation/devicetree/bindings/dma/dma-domain.yaml
```yaml
# SPDX-License-Identifier: GPL-2.0
%YAML 1.2
---
$id: http://devicetree.org/schemas/dma/dma-domain.yaml#
$schema: http://devicetree.org/meta-schemas/core.yaml#

title: DMA Domain Controller Definition

maintainers:
  - Vinod Koul <vkoul@kernel.org>

allOf:
  - $ref: /schemas/dma/dma-controller.yaml#

description:
  On systems where multiple DMA controllers available, none Slave (for example
  memcpy operation) users can not be described in DT as there is no device
  involved from the DMA controller's point of view, DMA binding is not usable.
  However in these systems still a peripheral might need to be serviced by or
  it is better to serviced by specific DMA controller.
  When a memcpy is used to/from a memory mapped region for example a DMA in the
  same domain can perform better.
  For generic software modules doing mem 2 mem operations it also matter that
  they will get a channel from a controller which is faster in DDR to DDR mode
  rather then from the first controller happen to be loaded.

  This property is inherited, so it may be specified in a device node or in any
  of its parent nodes.

properties:
  $dma-domain-controller:
    $ref: /schemas/types.yaml#definitions/phandle
    description:
      phande to the DMA controller node which should be used for the device or
      domain.

unevaluatedProperties: false
```

## Documentation/devicetree/bindings/leds/leds-pwm.txt
```
LED connected to PWM

Required properties:
- compatible : should be "pwm-leds".
- pwms : PWM property, please refer to: 
  Documentation/devicetree/bindings/pwm/pwm.txt
- pwm-names : (optional) Name to be used by the PWM subsystem for the PWM device
- label : (optional) The label for this LED.  If omitted, the label is
  taken from the node name (excluding the unit address).
- max-brightness : Maximum brightness possible for the LED
- linux,default-trigger :  (optional) This parameter, if present, is a
  string defining the trigger assigned to the LED.  Current triggers are:
    "backlight" - LED will act as a back-light, controlled by the framebuffer
		  system
    "default-on" - LED will turn on, but see "default-state" below
    "heartbeat" - LED "double" flashes at a load average based rate
    "ide-disk" - LED indicates disk activity
    "timer" - LED flashes at a fixed, configurable rate

Example:

twl_pwm: pwm {
	compatible = "ti,twl6030-pwm";
	#pwm-cells = <2>;
};

pwmled_keypad {
	compatible = "pwm-leds";
	pwms = <&twl_pwm 0 7812500>;
	pwm-names = "Keypad LED";

	label = "omap4::keypad";
	max-brightness = <127>;
};
```

## Documentation/devicetree/bindings/sound/soc/omap/omap-dmic.txt
```
* Texas Instruments OMAP4 Digital Microphone Module

Required properties:
  - compatible : "ti,omap4-dmic"
  - ti,hwmods  : List of hwmod names associated with DMIC, in most case
		 it is "dmic".

Example:

dmic_dai: dmic@4012e000 {
	compatible = "ti,omap4-dmic";
	ti,hwmods = "dmic";
};
```

## Documentation/devicetree/bindings/sound/soc/omap/omap-mcpdm.txt
```
* Texas Instruments OMAP4 McPDM

Required properties:
  - compatible : "ti,omap4-mcpdm"
  - ti,hwmods  : List of hwmod names associated with McPDM, in most case
                 it is "mcpdm".

Example:

mcpdm_dai: mcpdm@40132000 {
	compatible = "ti,omap4-mcpdm";
	ti,hwmods = "mcpdm";
};
```

## Documentation/devicetree/bindings/sound/ti,tas2555.txt
```
Texas Instruments - tas2555 Class-D Mono Audio Amplifier
		    http://www.ti.com/product/TAS2555

Required properties:
- compatible - "ti,tas2555"
- reg -  I2C slave address
- supply-*: Required supply regulators are:
	 "iovdd"	I/O power supply
	 "avdd"		Analog power supply
	 "dvdd"		Digital power supply

Optional properties:
- nreset-gpio - gpio pin to enable/disable the device
- supply-vbat - Battery power supply

tas2555 can receive it's reference clock via several pin: GPIO1-10, GPI1-3.
Three digital audio interface is available for connecting to CPU or other
audio component.

For system integration the dt-bindings/sound/tas2555.h header file provides
defined values to select the pin for MCLK and predefined values for selecting
the DAI to be used.

Example:

tas2555: tas2555@4c {
	#sound-dai-cells = <1>;
	compatible = "ti,tas2555";
	reg = <0x4c>;
	nreset-gpio = <&gpio4 2 GPIO_ACTIVE_HIGH>;

	iovdd-supply = <&boardio_fixed>;
	avdd-supply = <&aud18v_fixed>;
	dvdd-supply = <&aud18v_fixed>;
};

sound {
	compatible = "simple-audio-card";
	simple-audio-card,name = "TAS2555 card";
	simple-audio-card,widgets =
		"Speaker", "Speaker Port";
	simple-audio-card,routing =
		"Speaker Port",	"OUT",
		"Speaker Port",	"OUT";
	simple-audio-card,format = "i2s";
	simple-audio-card,bitclock-master = <&sound_master>;
	simple-audio-card,frame-master = <&sound_master>;

	status = "okay";

	sound_master: simple-audio-card,cpu {
		sound-dai = <&mcasp0>;
		system-clock-frequency = <24000000>;
		system-clock-id = <MCASP_CLK_HCLK_AUXCLK>;
	};

	simple-audio-card,codec {
		sound-dai = <&tas2555 TAS2555_DAI_ASI1>;
		clocks = <&clkout2_ck>;
	};
};
```

## Documentation/devicetree/bindings/video/backlight/pwm-backlight.txt
```
pwm-backlight bindings

Required properties:
  - compatible: "pwm-backlight"
  - pwms: OF device-tree PWM specification (see PWM binding[0])

  Brightness range can be configured with either "brightness-levels" or with
  "max-brightness-level".
  - brightness-levels: Array of distinct brightness levels. Typically these
      are in the range from 0 to 255, but any range starting at 0 will do.
      The actual brightness level (PWM duty cycle) will be interpolated
      from these values. 0 means a 0% duty cycle (darkest/off), while the
      last value in the array represents a 100% duty cycle (brightest).
  - max-brightness-level: The maximum brightness level the PWM supports. When
      the brightness is specified using this property the whole range from 0 to
      "max-brightness-level" will be available to configure.
  - default-brightness-level: the default brightness level. With
      "brightness-levels" it is an index into the array defined by the
      "brightness-levels" property. When it is used with "max-brightness-level"
      it is the value in the range from 0 to "max-brightness-level"

Optional properties:
  - pwm-names: a list of names for the PWM devices specified in the
               "pwms" property (see PWM binding[0])

[0]: Documentation/devicetree/bindings/pwm/pwm.txt

Example:

	backlight {
		compatible = "pwm-backlight";
		pwms = <&pwm 0 5000000>;

		brightness-levels = <0 4 8 16 32 64 128 255>;
		default-brightness-level = <6>;
	};
```
